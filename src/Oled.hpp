#pragma once
#include <cstdint>
#include <cstring>
#include <cstdio>
#include "driver/i2c.h"

namespace app
{
    // Minimal SSD1306 128x64 driver (I2C, address 0x3C)
    class Oled
    {
    private:
        static constexpr int W = 128;
        static constexpr int H = 64;
        static constexpr i2c_port_t PORT = I2C_NUM_0;
        static constexpr uint8_t ADDR = 0x3C;
        uint8_t m_buf[W * H / 8];
        bool m_ok = false;

        static const uint8_t *glyph(char c)
        {
            // 5x7 font: ' '..'Z', 6 blanks for [ \ ] ^ _ `, then 'a'..'z'
            static const uint8_t F[91][5] = {
                {0x00,0x00,0x00,0x00,0x00},{0x00,0x00,0x5F,0x00,0x00},{0x00,0x07,0x00,0x07,0x00},{0x14,0x7F,0x14,0x7F,0x14},
                {0x24,0x2A,0x7F,0x2A,0x12},{0x23,0x13,0x08,0x64,0x62},{0x36,0x49,0x56,0x20,0x50},{0x00,0x05,0x03,0x00,0x00},
                {0x00,0x1C,0x22,0x41,0x00},{0x00,0x41,0x22,0x1C,0x00},{0x2A,0x1C,0x7F,0x1C,0x2A},{0x08,0x08,0x3E,0x08,0x08},
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                {0x0C,0x50,0x50,0x50,0x3C},{0x44,0x64,0x54,0x4C,0x44}};
            int i = (c < 32 || c > 122) ? 0 : c - 32;
            return F[i];
        }

        esp_err_t cmd(uint8_t c)
        {
            uint8_t d[2] = {0x00, c};
            return i2c_master_write_to_device(PORT, ADDR, d, 2, pdMS_TO_TICKS(100));
        }

    public:
        static constexpr int PIN_SDA = 21;
        static constexpr int PIN_SCL = 22;

        bool init()
        {
            i2c_config_t cfg = {};
            cfg.mode = I2C_MODE_MASTER;
            cfg.sda_io_num = PIN_SDA;
            cfg.scl_io_num = PIN_SCL;
            cfg.sda_pullup_en = GPIO_PULLUP_ENABLE;
            cfg.scl_pullup_en = GPIO_PULLUP_ENABLE;
            cfg.master.clk_speed = 400000;
            i2c_param_config(PORT, &cfg);
            i2c_driver_install(PORT, I2C_MODE_MASTER, 0, 0, 0);

            static const uint8_t seq[] = {0xAE, 0xD5, 0x80, 0xA8, 0x3F, 0xD3, 0x00, 0x40, 0x8D, 0x14,
                                          0x20, 0x00, 0xA1, 0xC8, 0xDA, 0x12, 0x81, 0xCF, 0xD9, 0xF1,
                                          0xDB, 0x40, 0xA4, 0xA6, 0xAF};
            m_ok = true;
            for (uint8_t c : seq)
                if (cmd(c) != ESP_OK) { m_ok = false; break; }
            if (!m_ok) printf("OLED not found at 0x3C (check wiring)\n");
            clear();
            flush();
            return m_ok;
        }

        void clear() { memset(m_buf, 0, sizeof(m_buf)); }

        void pixel(int x, int y, bool on)
        {
            if (x < 0 || x >= W || y < 0 || y >= H) return;
            if (on) m_buf[x + (y / 8) * W] |= (1 << (y % 8));
            else    m_buf[x + (y / 8) * W] &= ~(1 << (y % 8));
        }

        void rect(int x, int y, int w, int h, bool fill = false, bool on = true)
        {
            for (int j = 0; j < h; j++)
                for (int i = 0; i < w; i++)
                    if (fill || i == 0 || j == 0 || i == w - 1 || j == h - 1)
                        pixel(x + i, y + j, on);
        }

        void ch(int x, int y, char c, int scale = 1, bool on = true)
        {
            const uint8_t *g = glyph(c);
            for (int col = 0; col < 5; col++)
                for (int row = 0; row < 7; row++)
                    if (g[col] & (1 << row))
                        rect(x + col * scale, y + row * scale, scale, scale, true, on);
        }

        int textWidth(const char *s, int scale = 1) { return (int)strlen(s) * 6 * scale; }

        void text(int x, int y, const char *s, int scale = 1, bool on = true)
        {
            for (; *s; s++, x += 6 * scale) ch(x, y, *s, scale, on);
        }

        void textCentered(int cx, int y, const char *s, int scale = 1, bool on = true)
        {
            text(cx - textWidth(s, scale) / 2, y, s, scale, on);
        }

        void flush()
        {
            if (!m_ok) return;
            cmd(0x21); cmd(0); cmd(W - 1);
            cmd(0x22); cmd(0); cmd(H / 8 - 1);
            for (int i = 0; i < (int)sizeof(m_buf); i += 128)
            {
                uint8_t chunk[129];
                chunk[0] = 0x40;
                memcpy(chunk + 1, m_buf + i, 128);
                i2c_master_write_to_device(PORT, ADDR, chunk, 129, pdMS_TO_TICKS(100));
            }
        }
    };
}